## config/west.yml
```yaml
manifest:
  remotes:
    - name: jridgewell
      url-base: https://github.com/jridgewell
  projects:
    - name: zmk
      remote: jridgewell
      revision: jrl-thb
      import: app/west.yml
  self:
    path: config
```
